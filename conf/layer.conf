## conf/layer.conf
```bitbake
# It really depends on order of the layers appearing in BBLAYERS
# variable in toplevel bblayers.conf file, where bitbake will search
# for .inc files and others where bitbake uses BBPATH since it will
# search the directories from first to last as specified in BBPATH
# Therefore if you want a given layer to be considered high priority
# for the .inc and .conf etc. then consider it adding at the beginning
# of BBPATH. For bblayers bitbake will use BBFILES_PRIORITY to resolve
# the recipe contention so the order of directories in BBFILES does
# not matter.

# We have a conf and classes directory, append to BBPATH
BBPATH .= ":${LAYERDIR}"

# We have a recipes directory, add to BBFILES
BBFILES += "${LAYERDIR}/recipes-*/*/*.bb ${LAYERDIR}/recipes-*/*/*.bbappend"

BBFILE_COLLECTIONS += "qt6-layer"
BBFILE_PATTERN_qt6-layer := "^${LAYERDIR}/"

# Define the priority for recipes (.bb files) from this layer,
# choosing carefully how this layer interacts with all of the
# other layers.

BBFILE_PRIORITY_qt6-layer = "${BBFILE_PRIORITY_core}"

# This should only be incremented on significant changes that will
# cause compatibility issues with other layers
LAYERVERSION_qt6-layer = "1"

LAYERDEPENDS_qt6-layer = "core"

LAYERSERIES_COMPAT_qt6-layer = "dunfell gatesgarth hardknott honister kirkstone"

LICENSE_PATH += "${LAYERDIR}/licenses"

IMAGE_FEATURES[validitems] += "qtcreator-debug"

QT_GIT_PROJECT ?= "qt"
QT_GIT ?= "git://code.qt.io"
QT_GIT_PROTOCOL ?= "git"
QT_EDITION ?= "opensource"

QT_COMMERCIAL_MODULES ?= "0"

# License mapping back to old license files
SPDXLICENSEMAP[GPL-3.0-only] = "GPL-3.0"
SPDXLICENSEMAP[LGPL-3.0-only] = "LGPL-3.0"
SPDXLICENSEMAP[GPL-2.0-or-later] = "GPL-2.0"
```
